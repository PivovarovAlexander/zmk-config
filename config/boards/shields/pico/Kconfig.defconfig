## config/boards/shields/pico/Kconfig.defconfig
```kconfig
# Copyright (c) 2021 The ZMK Contributors
# SPDX-License-Identifier: MIT

if SHIELD_PICO

    # Keyboard name
    config ZMK_KEYBOARD_NAME
        default "pico"

    # PCF8575 I/O Expander
    config I2C
        default y

endif
```
